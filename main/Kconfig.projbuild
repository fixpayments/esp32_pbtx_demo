## main/Kconfig.projbuild
```kconfig
menu "PBTX Client Configuration"

    config PBTXCLIENT_WIFI_SSID
        string "WiFi SSID"
        default "myssid"
        help
            SSID (network name) for the example to connect to.

    config PBTXCLIENT_WIFI_PASSWORD
        string "WiFi Password"
        default "mypassword"
        help
            WiFi password (WPA or WPA2) for the example to use.

    config PBTXCLIENT_MAXIMUM_RETRY
        int "Maximum retry"
        default 5
        help
            Set the Maximum retry to avoid station reconnecting to the AP unlimited when the AP is really inexistent.

    config PBTXCLIENT_RPC_URL
        string "PBTX-RPC URL"
        help
            URL of the RPC server

    config PBTXCLIENT_RPC_USE_TLS
        bool "Use TLS for PBTX-RPC"
        help
            Set if the RPC service is using HTTPS
    
endmenu
```
